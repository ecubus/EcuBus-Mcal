## boards/pc/configs/vcos/defconfig
```kconfig
CONFIG_APPS_DIR="../../apps"
CONFIG_ARCH="sim"
CONFIG_ARCH_BOARD_CUSTOM=y
CONFIG_ARCH_BOARD_CUSTOM_DIR="../../vendor/semidrive/boards/sim"
CONFIG_ARCH_BOARD_CUSTOM_DIR_RELPATH=y
CONFIG_ARCH_BOARD_CUSTOM_NAME="pc"
CONFIG_ARCH_CHIP="sim"
CONFIG_ARCH_CHIP_CUSTOM=y
CONFIG_ARCH_CHIP_CUSTOM_DIR="../../vendor/semidrive/chips/sim"
CONFIG_ARCH_CHIP_CUSTOM_DIR_RELPATH=y
CONFIG_ARCH_CHIP_CUSTOM_NAME=""
CONFIG_ARCH_CHIP_E3650=y
CONFIG_ARCH_HAVE_DEBUG=y
CONFIG_ARCH_INTERRUPTSTACK=4096
CONFIG_ARCH_SETJMP_H=y
CONFIG_ARCH_SIM=y
CONFIG_ARCH_STACKDUMP=y
CONFIG_ARM_THUMB=y
CONFIG_ARM_TOOLCHAIN_GNU=y
CONFIG_BMP=y
CONFIG_BMP_NCPUS=1
CONFIG_BOARDCTL_POWEROFF=y
CONFIG_BOARD_EARLY_INITIALIZE=y
CONFIG_BOARD_LOOPSPERMSEC=99369
CONFIG_BOOT_RUNFROMISRAM=y
CONFIG_BUILTIN=y
CONFIG_CAN_STACK=n
CONFIG_DEBUG_ASSERTIONS=y
CONFIG_DEBUG_FEATURES=y
CONFIG_DEBUG_FULLOPT=y
CONFIG_DEBUG_SYMBOLS=y
CONFIG_DEBUG_WARNING_AS_ERROR=y
CONFIG_DEV_ZERO=y
CONFIG_DRIVERS_NOTEDDR=n
CONFIG_DRIVERS_NOTERAM_BUFSIZE=65536
CONFIG_ETH_STACK=n
CONFIG_EXAMPLES_HELLO=n
CONFIG_EXPERIMENTAL=y
CONFIG_FS_PROCFS=y
CONFIG_INIT_ENTRYPOINT="e3650_init_main"
CONFIG_LIBC_EXECFUNCS=y
CONFIG_LIBC_IPv4_ADDRCONV=y
CONFIG_LIBC_MEMFD_ERROR=y
CONFIG_MODULE_BSWM=n
CONFIG_MODULE_CANIF=y
CONFIG_MODULE_CANNM=n
CONFIG_MODULE_CANSM=y
CONFIG_MODULE_CANTRCV1145=n
CONFIG_MODULE_COM=y
CONFIG_MODULE_COMM=y
CONFIG_MODULE_CRC=y
CONFIG_MODULE_ECUC=y
CONFIG_MODULE_ECUM=n
CONFIG_MODULE_ETHIF=n
CONFIG_MODULE_MEMIF=n
CONFIG_MODULE_MEMMAP=y
CONFIG_MODULE_NM=n
CONFIG_MODULE_NVM=n
CONFIG_MODULE_PDUR=y
CONFIG_MODULE_RTE=y
CONFIG_MODULE_TCPIP=n
CONFIG_NDEBUG=y
CONFIG_NSH_ARCHINIT=y
CONFIG_NSH_BUILTIN_APPS=y
CONFIG_NSH_BUILTIN_AS_COMMAND=y
CONFIG_NSH_CMDOPT_HEXDUMP=n
CONFIG_NSH_FILEIOSIZE=512
CONFIG_NSH_READLINE=y
CONFIG_NSH_SC=y
CONFIG_NSH_UART_IRQ=114
CONFIG_PREALLOC_TIMERS=4
CONFIG_RAM_SIZE=245760
CONFIG_RAM_START=0x70000000
CONFIG_RAW_BINARY=y
CONFIG_READLINE_CMD_HISTORY=y
CONFIG_RTC=y
CONFIG_RTC_ARCH=y
CONFIG_RTC_DRIVER=y
CONFIG_RT_FRAMEWORK=y
CONFIG_RT_FRAMEWORK_COUNTER=y
CONFIG_RT_FRAMEWORK_HOOK=n
CONFIG_RT_FRAMEWORK_IOC=n
CONFIG_RT_FRAMEWORK_IPICALL=n
CONFIG_RT_FRAMEWORK_MAX_CAT0_INT_LEVEL=0
CONFIG_RT_FRAMEWORK_MAX_CAT1_INT_LEVEL=2
CONFIG_RT_FRAMEWORK_MAX_CAT2_INT_LEVEL=9
CONFIG_RT_FRAMEWORK_MAX_INT_LEVEL=0
CONFIG_RT_FRAMEWORK_MAX_TP_INT_LEVEL=1
CONFIG_RT_FRAMEWORK_MIN_INT_LEVEL=30
CONFIG_RT_FRAMEWORK_MULTIAPP=y
CONFIG_RT_FRAMEWORK_SCHTBL=y
CONFIG_RT_FRAMEWORK_TIMER=n
CONFIG_SCHED_EVENTS=y
CONFIG_SCHED_WAITPID=y
CONFIG_SECURITY_CRC=y
CONFIG_SERVM_BSWM=n
CONFIG_SERVM_ECUM=n
CONFIG_SIM_EEP_DRIVER=n
CONFIG_SIM_IRQ_MANAGE_DISPATCH_BY_IRQID=y
CONFIG_SIM_M32=y
CONFIG_SIM_UART0_NAME="/dev/vttyS0"
CONFIG_SIM_UART1_NAME="/dev/vttyS1"
CONFIG_SIM_UART_NUMBER=2
CONFIG_SPINLOCK=y
CONFIG_STACK_COLORATION=y
CONFIG_START_MONTH=3
CONFIG_START_YEAR=2016
CONFIG_SYMTAB_ORDEREDBYNAME=y
CONFIG_SYSLOG_BUFFER=y
CONFIG_SYSLOG_DEVPATH="/dev/ttyS0"
CONFIG_SYSLOG_INTBUFFER=y
CONFIG_SYSLOG_MAX_CHANNELS=2
CONFIG_SYSTEM_NSH=y
CONFIG_SYSTEM_TRACE=n
CONFIG_SYS_CLOCK_HW_CYCLES_PER_SEC=24000000
CONFIG_TRACED=n
CONFIG_UART0_SERIAL_CONSOLE=y
CONFIG_USEC_PER_TICK=1000
CONFIG_MODULE_CAN=y
CONFIG_MODULE_DET=n
CONFIG_SIM_CAN_DRIVER=n
```

## components/Can/Kconfig
```kconfig
menu "PC MCAL"

config MODULE_CAN
	bool "PC MCAL CAN (EcuBus-Pro JSON-RPC)"
	default n
	---help---
		AUTOSAR Can driver for PC. Talks to EcuBus-Pro Simulate CAN
		via JSON-RPC (starts when a project Simulate device is open;
		default 127.0.0.1:17320).

endmenu
```
