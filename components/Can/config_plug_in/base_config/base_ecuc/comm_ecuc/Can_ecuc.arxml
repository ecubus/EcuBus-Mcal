AUTOSAR XML (schema 00046)
package /ActiveEcuC
  module config Can: implementation-config-variant=VARIANT-PRE-COMPILE
    CanGeneral
      CanPcRpc: CanRpcHost=127.0.0.1, CanRpcPort=17320, CanRpcSocketPath=, CanRpcAutoReconnect=true, CanRpcReconnectIntervalMs=500
